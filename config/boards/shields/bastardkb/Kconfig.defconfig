## config/boards/shields/bastardkb/Kconfig.defconfig
```kconfig
config SHIELD_BASTARDKB_RIGHT
    # Keyboard metadata
    config ZMK_KEYBOARD_NAME
        default "BastardKB Right"

    # Split role (right = central/master)
    config ZMK_SPLIT_ROLE_CENTRAL
        default y

    # Connectivity (USB + BLE)
    config ZMK_USB
        default y

    # BLE (already default, but explicit for clarity)
    config ZMK_BLE
        default y
    config ZMK_BLE_PERIPHERAL
        default n  # Right is central, left is peripheral

    # Display/OLED (if your PCB has it)
    config ZMK_DISPLAY
        default y

endif  # SHIELD_BASTARDKB_RIGHT

if SHIELD_BASTARDKB_LEFT || SHIELD_BASTARDKB_RIGHT
    config ZMK_SPLIT
        default y
endif
```
