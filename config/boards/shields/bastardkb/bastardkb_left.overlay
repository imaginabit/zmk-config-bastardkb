#include "bastardkb.overlay" // Notice that the main dtsi files are included in the overlay.

&nice_nano {
    compatible = "bastardkb_left";
};

CONFIG_ZMK_BLE=y;
CONFIG_ZMK_BLE_CENTRAL=y;
CONFIG_ZMK_DISPLAY=y;
